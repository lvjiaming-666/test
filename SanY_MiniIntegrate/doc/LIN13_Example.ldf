/*---------GLOBAL DEFINITIONS-----------*/

LIN_description_file;
LIN_protocol_version = "1.3";
LIN_language_version = "1.3";
LIN_speed = 19.2 kbps;

Nodes {
  Master: SeatECU, 5 ms, 0.1 ms ;
  Slaves: Motor1, Motor2 ;
}

Signals {
  Motor1LinError: 1, 0, Motor1, SeatECU ;
  Motor1Selection: 2, 0, SeatECU, Motor1 ;
  Motor1Temp: 8, 5, Motor1, SeatECU ;
}

Frames {
  Motor1Control: 48, SeatECU, 1 {
    Motor1Selection, 0 ;
  }
  Motor1State_Cycl: 51, Motor1, 6 {
    Motor1Temp, 0 ;
    Motor1LinError, 40 ;
  }
}

Schedule_tables {
 NormalTable {
    Motor1Control delay 50 ms ;
    Motor1State_Cycl delay 50 ms ;
  }
}
